## conf/machine/bananapi-m2m.conf
```bitbake
#@TYPE: Machine
#@NAME: Bananapi-M2M
#@DESCRIPTION: Machine configuration for the bananapi M2 Magic, based 
# on allwinner A33/R16 CPU http://bananapi.org/

require conf/machine/include/sun8i.inc

PREFERRED_VERSION_u-boot = "v2017.11%"

KERNEL_DEVICETREE = "sun8i-r16-bananapi-m2m.dtb"
UBOOT_MACHINE = "Bananapi_m2m_defconfig"
```
